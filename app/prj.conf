## CMakeLists.txt
```
#-------------------------------------------------------------------------------
# Zephyr Example Application
#
# Copyright (c) 2021 Nordic Semiconductor ASA
# SPDX-License-Identifier: Apache-2.0

cmake_minimum_required(VERSION 3.13.1)
set(BOARD nrf52840dk/nrf52840)
find_package(Zephyr REQUIRED HINTS $ENV{ZEPHYR_BASE})

project(app LANGUAGES C)

target_source(app PRIVATE src/main.c)
```

## prj.conf
```kconfig
# Copyright (c) 2021 Nordic Semiconductor ASA
# SPDX-License-Identifier: Apache-2.0
#
# This file contains selected Kconfig options for the application.

CONFIG_GPIO=y
CONFIG_PWM=y
CONFIG_SMF=y
CONFIG_COMPILER_WARNINGS_AS_ERRORS=y

# Enable logging and console
CONFIG_CONSOLE=y


# Direct printk and log output to RTT
CONFIG_USE_SEGGER_RTT=y
CONFIG_UART_CONSOLE=n
CONFIG_USE_SEGGER_RTT=y
```

## src/main.c
```c
#include <zephyr/kernel.h>
#include <zephyr/drivers/gpio.h>

#define LED0_NODE DT_ALIAS(led0)

static const struct gpio_dt_spec led0 = GPIO_DT_SPEC_GET(LED0_NODE, gpios);

int main(void)
{
	int ret;

	if(!gpio_is_ready_dt(&led0))
	{
		return -1;
	}

	ret = gpio_pin_configure_dt(&led0, GPIO_OUTPUT_ACTIVE);

	if(ret < 0)
	{
		return ret;
	}

	while(1)
	{
		gpio_pin_toggle_dt(&led0);
	}
	return 0;
}
```
